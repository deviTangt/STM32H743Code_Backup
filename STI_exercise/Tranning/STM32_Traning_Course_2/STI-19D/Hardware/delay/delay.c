//-----------------------------------------------------------------
// 程序描述:
//     基于程序延时的不同延时时基的程序：us,ms
// 作    者: 凌智电子
// 开始日期: 2020-11-11
// 完成日期: 2020-11-11
// 当前版本: V1.0
// 历史版本:
//   - V1.0: 基于STM32的延时：us,ms
// 调试工具: 凌智STM32H750核心板、LZE_ST_LINK2
// 说    明: 
//
//-----------------------------------------------------------------

//-----------------------------------------------------------------
// 头文件包含
//-----------------------------------------------------------------
#include "delay.h"
//-----------------------------------------------------------------
static uint32_t fac_us=0;	// us延时倍乘数
	   
//-----------------------------------------------------------------
// void SysTick_clkconfig(uint16_t SYSCLK)
//-----------------------------------------------------------------
// 
// 函数功能: SysTick参数配置
// 入口参数: u8 SYSCLK：系统时钟频率
// 返 回 值: 无
// 注意事项: 无
//
//-----------------------------------------------------------------
void SysTick_clkconfig(uint16_t SYSCLK)
{
  HAL_SYSTICK_CLKSourceConfig(SYSTICK_CLKSOURCE_HCLK);// SysTick频率为HCLK
	fac_us=SYSCLK;
}								    

//-----------------------------------------------------------------
// void delay_us(uint32_t nus)
//-----------------------------------------------------------------
// 
// 函数功能: SysTick延时us
// 入口参数: uint32_t nus：要延时的us数.	
// 返 回 值: 无
// 注意事项: nus:0~190887435(最大值即2^32/fac_us@fac_us=22.5)	
//
//-----------------------------------------------------------------
void delay_us(uint32_t nus)
{		
	uint32_t ticks;
	uint32_t told,tnow,tcnt=0;
	uint32_t reload=SysTick->LOAD;			// LOAD的值	    	 
	ticks=nus*fac_us; 						// 需要的节拍数 
	told=SysTick->VAL;        		// 刚进入时的计数器值
	while(1)
	{
		tnow=SysTick->VAL;	
		if(tnow!=told)
		{	    
			if(tnow<told)				// 这里注意一下SYSTICK是一个递减的计数器就可以了.
				tcnt+=told-tnow;	
			else 
				tcnt+=reload-tnow+told;	    
			told=tnow;
			if(tcnt>=ticks)
				break;						// 时间超过/等于要延迟的时间,则退出.
		}  
	};
}

//-----------------------------------------------------------------
// void delay_ms(uint16_t nms)
//-----------------------------------------------------------------
// 
// 函数功能: SysTick延时ms
// 入口参数: uint32_t nms：要延时的ms数
// 返 回 值: 无
// 注意事项: 无
//
//-----------------------------------------------------------------
void delay_ms(uint16_t nms)
{
	uint32_t i;
	for(i=0;i<nms;i++) 
		delay_us(1000);
}

//-----------------------------------------------------------------
// End Of File
//----------------------------------------------------------------- 	 
